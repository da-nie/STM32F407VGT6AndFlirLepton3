#include "hx8347d.h"
#include "stm32f4xx_hal.h"

//++++++++++++++++++++++++++++++++++++++++++++++++++++++++++++++++++++++++++++++++++++++++++++++++++++
//макроопределения
//++++++++++++++++++++++++++++++++++++++++++++++++++++++++++++++++++++++++++++++++++++++++++++++++++++

//контакты дисплея
#define HX8347D_GPIO_PIN_CS		GPIO_PIN_7
#define HX8347D_GPIO_CS				GPIOD

#define HX8347D_GPIO_PIN_RST	GPIO_PIN_1
#define HX8347D_GPIO_RST			GPIOE

#define HX8347D_GPIO_PIN_RS		GPIO_PIN_11
#define HX8347D_GPIO_RS				GPIOD

#define HX8347D_GPIO_PIN_WR		GPIO_PIN_5
#define HX8347D_GPIO_WR				GPIOD

#define HX8347D_GPIO_PIN_RD		GPIO_PIN_4
#define HX8347D_GPIO_RD				GPIOD


#define HX8347D_GPIO_PIN_D0		GPIO_PIN_14
#define HX8347D_GPIO_D0				GPIOD

#define HX8347D_GPIO_PIN_D1		GPIO_PIN_15
#define HX8347D_GPIO_D1				GPIOD

#define HX8347D_GPIO_PIN_D2		GPIO_PIN_0
#define HX8347D_GPIO_D2				GPIOD

#define HX8347D_GPIO_PIN_D3		GPIO_PIN_1
#define HX8347D_GPIO_D3				GPIOD

#define HX8347D_GPIO_PIN_D4		GPIO_PIN_7
#define HX8347D_GPIO_D4				GPIOE

#define HX8347D_GPIO_PIN_D5		GPIO_PIN_8
#define HX8347D_GPIO_D5				GPIOE

#define HX8347D_GPIO_PIN_D6		GPIO_PIN_9
#define HX8347D_GPIO_D6				GPIOE

#define HX8347D_GPIO_PIN_D7		GPIO_PIN_10
#define HX8347D_GPIO_D7				GPIOE


//определяем адреса для записи данных
#define LCD_DATA 0x60010000UL
// для записи команд
#define LCD_REG  0x60000000UL

//код команды паузы в миллисекундах
#define DELAY_CODE 0xFFFF


//----------------------------------------------------------------------------------------------------
//глобальные переменные
//----------------------------------------------------------------------------------------------------

volatile static long PrintYPosition=0;//позиция вывода строки

const unsigned char Font8x14[224][14]=
{
 { 0x00, 0x00, 0x00, 0x00, 0x00, 0x00, 0x00, 0x00, 0x00, 0x00, 0x00, 0x00, 0x00, 0x00},//' '=0x20 
 { 0x00, 0x10, 0x38, 0x38, 0x38, 0x10, 0x10, 0x10, 0x00, 0x10, 0x10, 0x00, 0x00, 0x00},//'!'=0x21 
 { 0x00, 0x66, 0x66, 0x22, 0x44, 0x00, 0x00, 0x00, 0x00, 0x00, 0x00, 0x00, 0x00, 0x00},//'"'=0x22 
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 { 0x00, 0x00, 0x00, 0x00, 0x7E, 0xCC, 0xCC, 0xFC, 0x6C, 0xCC, 0xCE, 0x00, 0x00, 0x00}
};


//инициализация дисплея
const unsigned short HX8347D_InitList[]=
{
 0x00EA,0x0000, //PTBA[15:8]  
 0x00EB,0x0020, //PTBA[7:0]  
 0x00EC,0x000C, //STBA[15:8]  
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 0x0027,0x00A3, //  
	
 //Gamma 2.2 Setting  
 0x0040,0x0000, //  
 0x0041,0x0000, //  
 0x0042,0x0001, //  
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 0x005D,0x00CC, //  
	
 //Power Voltage Setting  
 0x001B,0x001B, //VRH=4.65V  
 0x001A,0x0001, //BT (VGH~15V,VGL~-10V,DDVDH~5V)  
 0x0024,0x002F, //VMH(VCOM High voltage ~3.2V)  
 0x0025,0x0057, //VML(VCOM Low voltage -1.2V)  
	
 //****VCOM offset**///  
 0x0023,0x0097, //for Flicker adjust //can reload from OTP 
 
 //Power on Setting  
 0x0018,0x0036, //I/P_RADJ,N/P_RADJ, Normal mode 75Hz  
 0x0019,0x0001, //OSC_EN='1', start Osc  
 0x0001,0x0000, //DP_STB='0', out deep sleep  
 0x001F,0x0088,// GAS=1, VOMG=00, PON=0, DK=1, XDK=0, DVDH_TRI=0, STB=0  
 DELAY_CODE,5,  //delay(5)
 0x001F,0x0080,// GAS=1, VOMG=00, PON=0, DK=0, XDK=0, DVDH_TRI=0, STB=0  
 DELAY_CODE,5,  //delay(5)
 0x001F,0x0090,// GAS=1, VOMG=00, PON=1, DK=0, XDK=0, DVDH_TRI=0, STB=0  
 DELAY_CODE,5,  //delay(5)
 0x001F,0x00D0,// GAS=1, VOMG=10, PON=1, DK=0, XDK=0, DDVDH_TRI=0, STB=0  
 DELAY_CODE,5,  //delay(5)
	
 //262k/65k color selection  
 0x0017,0x0005, //default 0x0006 262k color // 0x0005 65k color  
	
 //SET PANEL  
 0x0036,0x0000, //SS_P, GS_P,REV_P,BGR_P  
	
 //Display ON Setting  
 0x0028,0x0038, //GON=1, DTE=1, D=1000  
 DELAY_CODE,40,  //delay(40)
 0x0028,0x003C, //GON=1, DTE=1, D=1100  
	
 //Set GRAM Area  
 0x0002,0x0000,  
 0x0003,0x0000, //Column Start  
 0x0004,0x0000,  
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 0x0009,0x003F, //Row End  
 //WR_8B_FORMAT(0x0022, //Start GRAM write  
 // Power Off Setting  
 0x0028,0x0038, //GON=ЎЇ1ЎЇ DTE=ЎЇ1ЎЇ D[1:0]=ЎЇ10ЎЇ  
 DELAY_CODE,40,  //delay(40)
 0x001F,0x0089, // GAS=1, VOMG=00, PON=0, DK=1, XDK=0, DVDH_TRI=0, STB=1  
 DELAY_CODE,40,  //delay(40)
 0x0028,0x0004, //GON=ЎЇ0ЎЇ DTE=ЎЇ0ЎЇ D[1:0]=ЎЇ01ЎЇ  
 DELAY_CODE,40,  //delay(40)
 0x0019,0x0000, //OSC_EN=ЎЇ0ЎЇ  
 DELAY_CODE,5,  //delay(5)
 //M51_WR_REG(U05_LCD_POWER_ON, 0x0000, //VCI & IOVCC OFF 
 
 //##################################################################  
 // ENTER IDLE mode Setting  
 0x0018,0x0034, //I/P_RADJ,N/P_RADJ, IDLE mode 55Hz  
 0x002F,0x0011, //IDLE mode line inversion  
 0x0001,0x0004, //IDLE='1' , enter IDLE mode  
	
 // EXIT IDLE mode Setting  
 0x0018,0x0036, //I/P_RADJ,N/P_RADJ, Normal mode 75Hz  
 0x002F,0x0011, //Normal mode line inversion  
 0x0001,0x0000, //IDLE='0', EXIT IDLE mode  
	
 //##################################################################  
 // ENTER Partial mode Setting 32line  
 0x0018,0x0036, //I/P_RADJ,N/P_RADJ Partial mode 75Hz  
 0x002F,0x0011, //Partial mode line inversion  
 0x0001,0x0001, //PTL='1', Enter Partial mode  
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 0x0026,0x0001, //refresh cycle=5frame  
	
 // EXIT Partial mode Setting  
 0x0018,0x0036, //I/P_RADJ,N/P_RADJ, Normal mode 75Hz  
 0x002F,0x0011, //Normal mode, line inversion  
 0x0001,0x0000, //PTL='0', EXIT Partial mode  
	
 // ENTER Partial + IDLE mode Setting 32line  
 0x0018,0x0036, //I/P_RADJ,N/P_RADJ, Partial mode 55Hz  
 0x002F,0x0011, // Partial + IDLE mode line inversion  
 0x0001,0x0009, // PTL='1' IDLE=ЎЇ1ЎЇ, Enter Partial + IDLE mode  
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 0x0026,0x0001, //refresh cycle=5frame  
	
 // EXIT Partial + IDLE mode Setting  
 0x0018,0x0036, //I/P_RADJ,N/P_RADJ ,Normal mode 75Hz  
 0x002F,0x0011, //Normal mode, line inversion  
 0x0001,0x0000, // PTL='0' IDLE=ЎЇ0ЎЇ, EXIT Partial + IDLE mode  
	
 //##################################################################  
 // Enter Sleep mode Setting  
 0x0028,0x00B8, //GON=ЎЇ1ЎЇ DTE=ЎЇ1ЎЇ D[1:0]=ЎЇ10ЎЇ  
 DELAY_CODE,40,  //delay(40)
 0x001F,0x0089, // GAS=1, VOMG=00, PON=0, DK=1, XDK=0, DVDH_TRI=0, STB=1  
 DELAY_CODE,40,  //delay(40)
 0x0028,0x0004, //GON=ЎЇ0ЎЇ DTE=ЎЇ0ЎЇ D[1:0]=ЎЇ01ЎЇ  
 DELAY_CODE,40,  //delay(40)
 0x0019,0x0000, //OSC_EN=ЎЇ0ЎЇ  
 DELAY_CODE,5,  //delay(5)
 // Exit Sleep mode Setting  
 0x0018,0x0036, //I/P_RADJ,N/P_RADJ, Normal mode 75Hz  
 0x0019,0x0001, //OSC_EN='1', start Osc  
 0x001F,0x0088,// GAS=1, VOMG=00, PON=0, DK=1, XDK=0, DVDH_TRI=0, STB=0  
 DELAY_CODE,5,  //delay(5)
 0x001F,0x0080,// GAS=1, VOMG=00, PON=0, DK=0, XDK=0, DVDH_TRI=0, STB=0  
 DELAY_CODE,5,  //delay(5)
 0x001F,0x0090,// GAS=1, VOMG=00, PON=1, DK=0, XDK=0, DVDH_TRI=0, STB=0  
 DELAY_CODE,5,  //delay(5)
 0x001F,0x00D0,// GAS=1, VOMG=10, PON=1, DK=0, XDK=0, DDVDH_TRI=0, STB=0  
 DELAY_CODE,5,  //delay(5)
 0x0028,0x0038, //GON=1, DTE=1, D=1000  
 DELAY_CODE,40,  //delay(40)
 0x0028,0x003F, //GON=1, DTE=1, D=1100  
 
 // Enter Deep Sleep mode Setting  
 0x0028,0x00B8, //GON=ЎЇ1ЎЇ DTE=ЎЇ1ЎЇ D[1:0]=ЎЇ10ЎЇ  
 DELAY_CODE,40,  //delay(40)
 0x001F,0x0089, // GAS=1, VOMG=00, PON=0, DK=1, XDK=0, DVDH_TRI=0, STB=1  
 DELAY_CODE,40,  //delay(40)
 0x0028,0x0004, //GON=ЎЇ0ЎЇ DTE=ЎЇ0ЎЇ D[1:0]=ЎЇ01ЎЇ  
 DELAY_CODE,40,  //delay(40)
 0x0019,0x0000, //OSC_EN=ЎЇ0ЎЇ  
 DELAY_CODE,5,  //delay(5)
 0x0001,0x00C0, //DP_STB[1:0]=ЎЇ11ЎЇ  
	
 // Exit Deep Sleep mode Setting  
 0x0001,0x0000, //DP_STB='0', out deep sleep  
 DELAY_CODE,10,  //delay(10)
 0x0019,0x0001, //OSC_EN='1', start Osc  
 0x001F,0x0088,// GAS=1, VOMG=00, PON=0, DK=1, XDK=0, DVDH_TRI=0, STB=0  
 DELAY_CODE,5,  //delay(5)
 0x001F,0x0080,// GAS=1, VOMG=00, PON=0, DK=0, XDK=0, DVDH_TRI=0, STB=0  
 DELAY_CODE,5,  //delay(5)
 0x001F,0x0090,// GAS=1, VOMG=00, PON=1, DK=0, XDK=0, DVDH_TRI=0, STB=0  
 DELAY_CODE,5,  //delay(5)
 0x001F,0x00D0,// GAS=1, VOMG=10, PON=1, DK=0, XDK=0, DDVDH_TRI=0, STB=0  
 DELAY_CODE,5,  //delay(5)
 0x0028,0x0038, //GON=1, DTE=1, D=1000  
 DELAY_CODE,40,  //delay(40)
 0x0028,0x003F //GON=1, DTE=1, D=1100  
};






//++++++++++++++++++++++++++++++++++++++++++++++++++++++++++++++++++++++++++++++++++++++++++++++++++++
//++++++++++++++++++++++++++++++++++++++++++++++++++++++++++++++++++++++++++++++++++++++++++++++++++++
//общие функции
//++++++++++++++++++++++++++++++++++++++++++++++++++++++++++++++++++++++++++++++++++++++++++++++++++++
//++++++++++++++++++++++++++++++++++++++++++++++++++++++++++++++++++++++++++++++++++++++++++++++++++++


//----------------------------------------------------------------------------------------------------
//инициализация портов LCD-экрана
//----------------------------------------------------------------------------------------------------
void HX8347D_InitGPIO(void)
{
 //настраиваем порты
 __HAL_RCC_GPIOD_CLK_ENABLE();
 __HAL_RCC_GPIOE_CLK_ENABLE();
	
 //GPIO_Pin – номера выводов, которые конфигурируются. Пример для нескольких выводов:
 //GPIO_InitStructure.GPIO_Pin = GPIO_Pin_0 | GPIO_Pin_1 | GPIO_Pin_2;
 //GPIO_Speed – задает скорость для выбранных выводов.
 //GPIO_Mode – задает режим работы выводов. 

 //настраиваем параметры портов
 GPIO_InitTypeDef HX8347D_GPIO_Init;

 HX8347D_GPIO_Init.Mode=GPIO_MODE_OUTPUT_PP;
 HX8347D_GPIO_Init.Pull=GPIO_NOPULL;
 HX8347D_GPIO_Init.Speed=GPIO_SPEED_FREQ_VERY_HIGH; 

 HX8347D_GPIO_Init.Pin=HX8347D_GPIO_PIN_CS;
 HAL_GPIO_Init(HX8347D_GPIO_CS,&HX8347D_GPIO_Init);

 HX8347D_GPIO_Init.Pin=HX8347D_GPIO_PIN_RS;
 HAL_GPIO_Init(HX8347D_GPIO_RS,&HX8347D_GPIO_Init);

 HX8347D_GPIO_Init.Pin=HX8347D_GPIO_PIN_RST;
 HAL_GPIO_Init(HX8347D_GPIO_RST,&HX8347D_GPIO_Init);

 HX8347D_GPIO_Init.Pin=HX8347D_GPIO_PIN_RD;
 HAL_GPIO_Init(HX8347D_GPIO_RD,&HX8347D_GPIO_Init);

 HX8347D_GPIO_Init.Pin=HX8347D_GPIO_PIN_WR;
 HAL_GPIO_Init(HX8347D_GPIO_WR,&HX8347D_GPIO_Init);
 

 HX8347D_GPIO_Init.Pin=HX8347D_GPIO_PIN_D0;
 HAL_GPIO_Init(HX8347D_GPIO_D0,&HX8347D_GPIO_Init);

 HX8347D_GPIO_Init.Pin=HX8347D_GPIO_PIN_D1;
 HAL_GPIO_Init(HX8347D_GPIO_D1,&HX8347D_GPIO_Init);

 HX8347D_GPIO_Init.Pin=HX8347D_GPIO_PIN_D2;
 HAL_GPIO_Init(HX8347D_GPIO_D2,&HX8347D_GPIO_Init);

 HX8347D_GPIO_Init.Pin=HX8347D_GPIO_PIN_D3;
 HAL_GPIO_Init(HX8347D_GPIO_D3,&HX8347D_GPIO_Init);

 HX8347D_GPIO_Init.Pin=HX8347D_GPIO_PIN_D4;
 HAL_GPIO_Init(HX8347D_GPIO_D4,&HX8347D_GPIO_Init);

 HX8347D_GPIO_Init.Pin=HX8347D_GPIO_PIN_D5;
 HAL_GPIO_Init(HX8347D_GPIO_D5,&HX8347D_GPIO_Init);

 HX8347D_GPIO_Init.Pin=HX8347D_GPIO_PIN_D6;
 HAL_GPIO_Init(HX8347D_GPIO_D6,&HX8347D_GPIO_Init);

 HX8347D_GPIO_Init.Pin=HX8347D_GPIO_PIN_D7;
 HAL_GPIO_Init(HX8347D_GPIO_D7,&HX8347D_GPIO_Init);
}

//----------------------------------------------------------------------------------------------------
//инициализация LCD-экрана
//----------------------------------------------------------------------------------------------------
void HX8347D_Init(void)
{
 //инициализируем дисплей
 HX8347D_Reset();
 HX8347D_CS_Zero();
	
 long command_amount=sizeof(HX8347D_InitList)/sizeof(unsigned short);
 for(long n=0;n<command_amount;)
 {
  unsigned short reg=HX8347D_InitList[n];
  n++;
  unsigned short value=HX8347D_InitList[n];
  n++;
  if (reg==DELAY_CODE)//пауза
  {
   HAL_Delay(value);  
   continue;
  }
  //значение для регистра
  HX8347D_WriteRegister16(reg,value);  
 }
}
//----------------------------------------------------------------------------------------------------
//выставить на CS 1
//----------------------------------------------------------------------------------------------------
void HX8347D_CS_One(void)
{
 HAL_GPIO_WritePin(HX8347D_GPIO_CS,HX8347D_GPIO_PIN_CS,GPIO_PIN_SET);
}
//----------------------------------------------------------------------------------------------------
//выставить на CS 0
//----------------------------------------------------------------------------------------------------
void HX8347D_CS_Zero(void)
{
 HAL_GPIO_WritePin(HX8347D_GPIO_CS,HX8347D_GPIO_PIN_CS,GPIO_PIN_RESET);
}
//----------------------------------------------------------------------------------------------------
//выставить на RS 1
//----------------------------------------------------------------------------------------------------
void HX8347D_RS_One(void)
{
 HAL_GPIO_WritePin(HX8347D_GPIO_RS,HX8347D_GPIO_PIN_RS,GPIO_PIN_SET);
}
//----------------------------------------------------------------------------------------------------
//выставить на RS 0
//----------------------------------------------------------------------------------------------------
void HX8347D_RS_Zero(void)
{
  HAL_GPIO_WritePin(HX8347D_GPIO_RS,HX8347D_GPIO_PIN_RS,GPIO_PIN_RESET);
}
//----------------------------------------------------------------------------------------------------
//выставить на WR 1
//----------------------------------------------------------------------------------------------------
void HX8347D_WR_One(void)
{
 HAL_GPIO_WritePin(HX8347D_GPIO_WR,HX8347D_GPIO_PIN_WR,GPIO_PIN_SET);
}
//----------------------------------------------------------------------------------------------------
//выставить на WR 0
//----------------------------------------------------------------------------------------------------
void HX8347D_WR_Zero(void)
{
 HAL_GPIO_WritePin(HX8347D_GPIO_WR,HX8347D_GPIO_PIN_WR,GPIO_PIN_RESET);
}
//----------------------------------------------------------------------------------------------------
//выставить на RST 1
//----------------------------------------------------------------------------------------------------
void HX8347D_RST_One(void)
{
 HAL_GPIO_WritePin(HX8347D_GPIO_RST,HX8347D_GPIO_PIN_RST,GPIO_PIN_SET);
}
//----------------------------------------------------------------------------------------------------
//выставить на RST 0
//----------------------------------------------------------------------------------------------------
void HX8347D_RST_Zero(void)
{
 HAL_GPIO_WritePin(HX8347D_GPIO_RST,HX8347D_GPIO_PIN_RST,GPIO_PIN_RESET);
}
//----------------------------------------------------------------------------------------------------
//выставить на RD 1
//----------------------------------------------------------------------------------------------------
void HX8347D_RD_One(void)
{
 HAL_GPIO_WritePin(HX8347D_GPIO_RD,HX8347D_GPIO_PIN_RD,GPIO_PIN_SET);
}
//----------------------------------------------------------------------------------------------------
//выставить на RD 0
//----------------------------------------------------------------------------------------------------
void HX8347D_RD_Zero(void)
{
 HAL_GPIO_WritePin(HX8347D_GPIO_RD,HX8347D_GPIO_PIN_RD,GPIO_PIN_RESET);
}
//----------------------------------------------------------------------------------------------------
//выполнить сброс
//----------------------------------------------------------------------------------------------------
void HX8347D_Reset(void)
{
 HX8347D_CS_One();
 HX8347D_RS_One();
 HX8347D_RD_One();
 HX8347D_WR_One();
 HX8347D_RST_One();    
 HAL_Delay(10);
 HX8347D_RST_Zero();
 HAL_Delay(10);
 HX8347D_RST_One();
 HAL_Delay(250);
}
//----------------------------------------------------------------------------------------------------
//передать байт
//----------------------------------------------------------------------------------------------------
void HX8347D_Write8(unsigned char byte)
{ 
 *((volatile uint8_t*)(LCD_DATA))=byte;
}
//----------------------------------------------------------------------------------------------------
//передать 16 бит 
//----------------------------------------------------------------------------------------------------
void HX8347D_Write16(unsigned short value) 
{ 
 HX8347D_Write8((value>>8)&0xFF);
 HX8347D_Write8(value&0xFF);
}
//----------------------------------------------------------------------------------------------------
//выбрать регистр
//----------------------------------------------------------------------------------------------------
void HX8347D_SelectRegister(unsigned short reg) 
{ 
 *((volatile uint8_t*)(LCD_REG))=(reg>>8)&0xFF;
 *((volatile uint8_t*)(LCD_REG))=reg&0xFF;
}
//----------------------------------------------------------------------------------------------------
//записать в регистр 16 бит
//----------------------------------------------------------------------------------------------------
void HX8347D_WriteRegister16(unsigned short reg,unsigned short value) 
{ 
 HX8347D_SelectRegister(reg);	
 HX8347D_Write16(value);
}
//----------------------------------------------------------------------------------------------------
//задать окно
//----------------------------------------------------------------------------------------------------
inline void HX8347D_SetWindow(unsigned short x_left,unsigned short y_top,unsigned short x_right,unsigned short y_bottom)
{
 HX8347D_WriteRegister16(0x002,(x_left>>8)&0xFF);
 HX8347D_WriteRegister16(0x003,(x_left)&0xFF);

 HX8347D_WriteRegister16(0x004,(x_right>>8)&0xFF);
 HX8347D_WriteRegister16(0x005,(x_right)&0xFF);

 HX8347D_WriteRegister16(0x006,(y_top>>8)&0xFF);
 HX8347D_WriteRegister16(0x007,(y_top)&0xFF);

 HX8347D_WriteRegister16(0x008,(y_bottom>>8)&0xFF);
 HX8347D_WriteRegister16(0x009,(y_bottom)&0xFF);
 //выбираем регистр вывода изображения	
 HX8347D_SelectRegister(0x22);
}
//------------------------------------------------------------------------------
//передать цвет точки
//------------------------------------------------------------------------------
void HX8347D_OutColor(unsigned short color)
{
 HX8347D_Write16(color);
}

//------------------------------------------------------------------------------
//вывести один пиксель
//------------------------------------------------------------------------------
void HX8347D_PutPixel(unsigned short x, unsigned short y, unsigned short color)
{
 HX8347D_SetWindow(x,y,x,y);
 HX8347D_OutColor(color);
}

//----------------------------------------------------------------------------------------------------
//вывод символа в позицию
//----------------------------------------------------------------------------------------------------
void HX8347D_PutSymbol(unsigned short x,unsigned short y,char symbol,unsigned short color)
{ 
 unsigned char s=(unsigned char)(symbol);
 if (s<=32) return;
 s-=32;
 if (s>223) return;
 //рисуем символ
 for(unsigned short ys=0;ys<FONT_HEIGHT;ys++)
 {
  unsigned char byte=Font8x14[s][ys];
  unsigned char mask=128;
  for(unsigned short xs=0;xs<FONT_WIDTH;xs++,mask>>=1)
  {   
   if (x+xs<0 || x+xs>=HX8347D_WIDTH) continue;
   if (y+ys<0 || y+ys>=HX8347D_HEIGHT) continue;
   if (byte&mask) HX8347D_PutPixel(x+xs,y+ys,color);
  }
 }
}

//----------------------------------------------------------------------------------------------------
//вывод строчки в позицию
//----------------------------------------------------------------------------------------------------
void HX8347D_PutString(unsigned short x,unsigned short y,const char *string,unsigned short color)
{
 long s=0;	
 while((*string)!=0)
 {
  HX8347D_PutSymbol(x,y,*string,color);
	x+=FONT_WIDTH;  
	string++;
	s++;
	if (s>20) break;
 }
}

//----------------------------------------------------------------------------------------------------
//вывести текст в текущую позицию
//----------------------------------------------------------------------------------------------------
void HX8347D_Print(const char *string,unsigned short color)
{
 if (PrintYPosition+FONT_HEIGHT>=HX8347D_HEIGHT) HX8347D_Clear(HX8347D_BLACK);
 HX8347D_PutString(0,PrintYPosition,string,color);
 PrintYPosition+=FONT_HEIGHT;
}
//----------------------------------------------------------------------------------------------------
//сбросить текущую позицию
//----------------------------------------------------------------------------------------------------
void HX8347D_Clear(unsigned short color)
{
 PrintYPosition=0;	
 HX8347D_SetWindow(0,0,HX8347D_WIDTH-1,HX8347D_HEIGHT-1);
 //выбираем регистр вывода изображения
 HX8347D_SelectRegister(0x22);
 for(unsigned short y=0;y<HX8347D_HEIGHT;y++)
 {
  for(unsigned short x=0;x<HX8347D_WIDTH;x++)
  {
   HX8347D_Write16(color);
  }
 }
}












