#include "il9325.h"

//****************************************************************************************************
//макроопределения
//****************************************************************************************************

//контакты дисплея
#define IL9325_GPIO_PIN_CS		GPIO_PIN_7
#define IL9325_GPIO_CS				GPIOD

#define IL9325_GPIO_PIN_RST	GPIO_PIN_1
#define IL9325_GPIO_RST			GPIOE

#define IL9325_GPIO_PIN_RS		GPIO_PIN_11
#define IL9325_GPIO_RS				GPIOD

#define IL9325_GPIO_PIN_WR		GPIO_PIN_5
#define IL9325_GPIO_WR				GPIOD

#define IL9325_GPIO_PIN_RD		GPIO_PIN_4
#define IL9325_GPIO_RD				GPIOD


#define IL9325_GPIO_PIN_D0		GPIO_PIN_14
#define IL9325_GPIO_D0				GPIOD

#define IL9325_GPIO_PIN_D1		GPIO_PIN_15
#define IL9325_GPIO_D1				GPIOD

#define IL9325_GPIO_PIN_D2		GPIO_PIN_0
#define IL9325_GPIO_D2				GPIOD

#define IL9325_GPIO_PIN_D3		GPIO_PIN_1
#define IL9325_GPIO_D3				GPIOD

#define IL9325_GPIO_PIN_D4		GPIO_PIN_7
#define IL9325_GPIO_D4				GPIOE

#define IL9325_GPIO_PIN_D5		GPIO_PIN_8
#define IL9325_GPIO_D5				GPIOE

#define IL9325_GPIO_PIN_D6		GPIO_PIN_9
#define IL9325_GPIO_D6				GPIOE

#define IL9325_GPIO_PIN_D7		GPIO_PIN_10
#define IL9325_GPIO_D7				GPIOE

//определяем адреса для записи данных
#define LCD_DATA 0x60010000UL
// для записи команд
#define LCD_REG  0x60000000UL

//код команды паузы в миллисекундах
#define DELAY_CODE 0xFFFF

#define TFTLCD_DELAY DELAY_CODE

#define FONT_HEIGHT 14
#define FONT_WIDTH 8

//----------------------------------------------------------------------------------------------------
//глобальные переменные
//----------------------------------------------------------------------------------------------------

volatile static int32_t PrintYPosition=0;//позиция вывода строки

static const uint8_t Font8x14[224][14]=
{
 { 0x00, 0x00, 0x00, 0x00, 0x00, 0x00, 0x00, 0x00, 0x00, 0x00, 0x00, 0x00, 0x00, 0x00},//' '=0x20 
 { 0x00, 0x10, 0x38, 0x38, 0x38, 0x10, 0x10, 0x10, 0x00, 0x10, 0x10, 0x00, 0x00, 0x00},//'!'=0x21 
 { 0x00, 0x66, 0x66, 0x22, 0x44, 0x00, 0x00, 0x00, 0x00, 0x00, 0x00, 0x00, 0x00, 0x00},//'"'=0x22 
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 { 0x00, 0x00, 0x00, 0x00, 0x7E, 0xCC, 0xCC, 0xFC, 0x6C, 0xCC, 0xCE, 0x00, 0x00, 0x00}
};

//инициализация дисплея
static const uint16_t IL9325_InitList[]=
{
  ILI932X_START_OSC        , 0x0001, // Start oscillator
  TFTLCD_DELAY             , 50,     // 50 millisecond delay
  ILI932X_DRIV_OUT_CTRL    , 0x0100,
  ILI932X_DRIV_WAV_CTRL    , 0x0700,
  ILI932X_ENTRY_MOD        , 0x1030,
  ILI932X_RESIZE_CTRL      , 0x0000,
  ILI932X_DISP_CTRL2       , 0x0202,
  ILI932X_DISP_CTRL3       , 0x0000,
  ILI932X_DISP_CTRL4       , 0x0000,
  ILI932X_RGB_DISP_IF_CTRL1, 0x0,
  ILI932X_FRM_MARKER_POS   , 0x0,
  ILI932X_RGB_DISP_IF_CTRL2, 0x0,
  ILI932X_POW_CTRL1        , 0x0000,
  ILI932X_POW_CTRL2        , 0x0007,
  ILI932X_POW_CTRL3        , 0x0000,
  ILI932X_POW_CTRL4        , 0x0000,
  TFTLCD_DELAY             , 50,
  ILI932X_POW_CTRL1        , 0x1690,
  ILI932X_POW_CTRL2        , 0x0227,
  TFTLCD_DELAY             , 50,
  ILI932X_POW_CTRL3        , 0x001A,
  TFTLCD_DELAY             , 50,
  ILI932X_POW_CTRL4        , 0x1800,
  ILI932X_POW_CTRL7        , 0x002A,
  TFTLCD_DELAY             , 50,
  ILI932X_GAMMA_CTRL1      , 0x0000,
  ILI932X_GAMMA_CTRL2      , 0x0000,
  ILI932X_GAMMA_CTRL3      , 0x0000,
  ILI932X_GAMMA_CTRL4      , 0x0206,
  ILI932X_GAMMA_CTRL5      , 0x0808,
  ILI932X_GAMMA_CTRL6      , 0x0007,
  ILI932X_GAMMA_CTRL7      , 0x0201,
  ILI932X_GAMMA_CTRL8      , 0x0000,
  ILI932X_GAMMA_CTRL9      , 0x0000,
  ILI932X_GAMMA_CTRL10     , 0x0000,
  ILI932X_GRAM_HOR_AD      , 0x0000,
  ILI932X_GRAM_VER_AD      , 0x0000,
  ILI932X_HOR_START_AD     , 0x0000,
  ILI932X_HOR_END_AD       , 0x00EF,
  ILI932X_VER_START_AD     , 0X0000,
  ILI932X_VER_END_AD       , 0x013F,
  ILI932X_GATE_SCAN_CTRL1  , 0xA700, // Driver Output Control (R60h)
  ILI932X_GATE_SCAN_CTRL2  , 0x0003, // Driver Output Control (R61h)
  ILI932X_GATE_SCAN_CTRL3  , 0x0000, // Driver Output Control (R62h)
  ILI932X_PANEL_IF_CTRL1   , 0x0010, // Panel Interface Control 1 (R90h)
  ILI932X_PANEL_IF_CTRL2   , 0x0000,
  ILI932X_PANEL_IF_CTRL3   , 0x0003,
  ILI932X_PANEL_IF_CTRL4   , 0x1100,
  ILI932X_PANEL_IF_CTRL5   , 0x0000,
  ILI932X_PANEL_IF_CTRL6   , 0x0000,
  ILI932X_DISP_CTRL1			 , 0x0133, // Main screen turn on	
//https://github.com/adafruit/TFTLCD-Library/blob/master/Adafruit_TFTLCD.cpp
			
};

//****************************************************************************************************
//****************************************************************************************************
//общие функции
//****************************************************************************************************
//****************************************************************************************************

//----------------------------------------------------------------------------------------------------
//инициализация портов LCD-экрана
//----------------------------------------------------------------------------------------------------
void IL9325_InitGPIO(void)
{
 //настраиваем порты

 __HAL_RCC_GPIOD_CLK_ENABLE();
 __HAL_RCC_GPIOE_CLK_ENABLE();
	
 //GPIO_Pin – номера выводов, которые конфигурируются. Пример для нескольких выводов:
 //GPIO_InitStructure.GPIO_Pin = GPIO_Pin_0 | GPIO_Pin_1 | GPIO_Pin_2;
 //GPIO_Speed – задает скорость для выбранных выводов.
 //GPIO_Mode – задает режим работы выводов. 

 //настраиваем параметры портов
 GPIO_InitTypeDef IL9325_GPIO_Init;

 IL9325_GPIO_Init.Mode=GPIO_MODE_OUTPUT_PP;
 IL9325_GPIO_Init.Pull=GPIO_NOPULL;
 IL9325_GPIO_Init.Speed=GPIO_SPEED_FREQ_VERY_HIGH;

 IL9325_GPIO_Init.Pin=IL9325_GPIO_PIN_CS;
 HAL_GPIO_Init(IL9325_GPIO_CS,&IL9325_GPIO_Init);

 IL9325_GPIO_Init.Pin=IL9325_GPIO_PIN_RS;
 HAL_GPIO_Init(IL9325_GPIO_RS,&IL9325_GPIO_Init);

 IL9325_GPIO_Init.Pin=IL9325_GPIO_PIN_RST;
 HAL_GPIO_Init(IL9325_GPIO_RST,&IL9325_GPIO_Init);

 IL9325_GPIO_Init.Pin=IL9325_GPIO_PIN_RD;
 HAL_GPIO_Init(IL9325_GPIO_RD,&IL9325_GPIO_Init);

 IL9325_GPIO_Init.Pin=IL9325_GPIO_PIN_WR;
 HAL_GPIO_Init(IL9325_GPIO_WR,&IL9325_GPIO_Init);
 

 IL9325_GPIO_Init.Pin=IL9325_GPIO_PIN_D0;
 HAL_GPIO_Init(IL9325_GPIO_D0,&IL9325_GPIO_Init);

 IL9325_GPIO_Init.Pin=IL9325_GPIO_PIN_D1;
 HAL_GPIO_Init(IL9325_GPIO_D1,&IL9325_GPIO_Init);

 IL9325_GPIO_Init.Pin=IL9325_GPIO_PIN_D2;
 HAL_GPIO_Init(IL9325_GPIO_D2,&IL9325_GPIO_Init);

 IL9325_GPIO_Init.Pin=IL9325_GPIO_PIN_D3;
 HAL_GPIO_Init(IL9325_GPIO_D3,&IL9325_GPIO_Init);

 IL9325_GPIO_Init.Pin=IL9325_GPIO_PIN_D4;
 HAL_GPIO_Init(IL9325_GPIO_D4,&IL9325_GPIO_Init);

 IL9325_GPIO_Init.Pin=IL9325_GPIO_PIN_D5;
 HAL_GPIO_Init(IL9325_GPIO_D5,&IL9325_GPIO_Init);

 IL9325_GPIO_Init.Pin=IL9325_GPIO_PIN_D6;
 HAL_GPIO_Init(IL9325_GPIO_D6,&IL9325_GPIO_Init);

 IL9325_GPIO_Init.Pin=IL9325_GPIO_PIN_D7;
 HAL_GPIO_Init(IL9325_GPIO_D7,&IL9325_GPIO_Init);

}

//----------------------------------------------------------------------------------------------------
//инициализация LCD-экрана
//----------------------------------------------------------------------------------------------------
void IL9325_Init(void)
{
 //инициализируем дисплей
 IL9325_Reset();
 IL9325_CS_Zero();
 
 uint32_t command_amount=sizeof(IL9325_InitList)/sizeof(uint16_t);
 for(uint32_t n=0;n<command_amount;)
 {
  uint16_t reg=IL9325_InitList[n];
  n++;
  uint16_t value=IL9325_InitList[n];
  n++;
  if (reg==DELAY_CODE)//пауза
  {
   HAL_Delay(value);  
   continue;
  }
  //значение для регистра
  IL9325_WriteRegister16(reg,value);  
 }
}
//----------------------------------------------------------------------------------------------------
//выставить на CS 1
//----------------------------------------------------------------------------------------------------
inline void IL9325_CS_One(void)
{
 HAL_GPIO_WritePin(IL9325_GPIO_CS,IL9325_GPIO_PIN_CS,GPIO_PIN_SET);
}
//----------------------------------------------------------------------------------------------------
//выставить на CS 0
//----------------------------------------------------------------------------------------------------
inline void IL9325_CS_Zero(void)
{
 HAL_GPIO_WritePin(IL9325_GPIO_CS,IL9325_GPIO_PIN_CS,GPIO_PIN_RESET);
}
//----------------------------------------------------------------------------------------------------
//выставить на RS 1
//----------------------------------------------------------------------------------------------------
inline void IL9325_RS_One(void)
{
 HAL_GPIO_WritePin(IL9325_GPIO_RS,IL9325_GPIO_PIN_RS,GPIO_PIN_SET);
}
//----------------------------------------------------------------------------------------------------
//выставить на RS 0
//----------------------------------------------------------------------------------------------------
inline void IL9325_RS_Zero(void)
{
  HAL_GPIO_WritePin(IL9325_GPIO_RS,IL9325_GPIO_PIN_RS,GPIO_PIN_RESET);
}
//----------------------------------------------------------------------------------------------------
//выставить на WR 1
//----------------------------------------------------------------------------------------------------
inline void IL9325_WR_One(void)
{
 HAL_GPIO_WritePin(IL9325_GPIO_WR,IL9325_GPIO_PIN_WR,GPIO_PIN_SET);
}
//----------------------------------------------------------------------------------------------------
//выставить на WR 0
//----------------------------------------------------------------------------------------------------
inline void IL9325_WR_Zero(void)
{
 HAL_GPIO_WritePin(IL9325_GPIO_WR,IL9325_GPIO_PIN_WR,GPIO_PIN_RESET);
}
//----------------------------------------------------------------------------------------------------
//выставить на RST 1
//----------------------------------------------------------------------------------------------------
inline void IL9325_RST_One(void)
{
 HAL_GPIO_WritePin(IL9325_GPIO_RST,IL9325_GPIO_PIN_RST,GPIO_PIN_SET);
}
//----------------------------------------------------------------------------------------------------
//выставить на RST 0
//----------------------------------------------------------------------------------------------------
inline void IL9325_RST_Zero(void)
{
 HAL_GPIO_WritePin(IL9325_GPIO_RST,IL9325_GPIO_PIN_RST,GPIO_PIN_RESET);
}
//----------------------------------------------------------------------------------------------------
//выставить на RD 1
//----------------------------------------------------------------------------------------------------
inline void IL9325_RD_One(void)
{
 HAL_GPIO_WritePin(IL9325_GPIO_RD,IL9325_GPIO_PIN_RD,GPIO_PIN_SET);
}
//----------------------------------------------------------------------------------------------------
//выставить на RD 0
//----------------------------------------------------------------------------------------------------
inline void IL9325_RD_Zero(void)
{
 HAL_GPIO_WritePin(IL9325_GPIO_RD,IL9325_GPIO_PIN_RD,GPIO_PIN_RESET);
}
//----------------------------------------------------------------------------------------------------
//задать значение на шине данных
//----------------------------------------------------------------------------------------------------
inline void IL9325_SetData(uint8_t byte)
{
 uint32_t inv_byte=0xFF^byte;
 uint32_t pr_byte=byte;
 IL9325_GPIO_D0->BSRR=(pr_byte<<4UL)|(inv_byte<<(4UL+16UL));

 /*
 unsigned long port_d=0;
 if (byte&1) port_d|=IL9325_GPIO_PIN_D0;
	      else port_d|=IL9325_GPIO_PIN_D0<<16UL;
 if (byte&2) port_d|=IL9325_GPIO_PIN_D1;
	      else port_d|=IL9325_GPIO_PIN_D1<<16UL;
 if (byte&4) port_d|=IL9325_GPIO_PIN_D2;
	      else port_d|=IL9325_GPIO_PIN_D2<<16UL;
 if (byte&8) port_d|=IL9325_GPIO_PIN_D3;
	      else port_d|=IL9325_GPIO_PIN_D3<<16UL;
	
 unsigned long port_e=0;
 if (byte&16) port_e|=IL9325_GPIO_PIN_D4;
	      else port_e|=IL9325_GPIO_PIN_D4<<16UL;
 if (byte&32) port_e|=IL9325_GPIO_PIN_D5;
	      else port_e|=IL9325_GPIO_PIN_D5<<16UL;
 if (byte&64) port_e|=IL9325_GPIO_PIN_D6;
	      else port_e|=IL9325_GPIO_PIN_D6<<16UL;
 if (byte&128) port_e|=IL9325_GPIO_PIN_D7;
	      else port_e|=IL9325_GPIO_PIN_D7<<16UL;

 IL9325_GPIO_D0->BSRR=port_d;
 IL9325_GPIO_D4->BSRR=port_e;
*/
/*
 if (byte&1) HAL_GPIO_WritePin(IL9325_GPIO_D0,IL9325_GPIO_PIN_D0,GPIO_PIN_SET);
        else HAL_GPIO_WritePin(IL9325_GPIO_D0,IL9325_GPIO_PIN_D0,GPIO_PIN_RESET);
 if (byte&2) HAL_GPIO_WritePin(IL9325_GPIO_D1,IL9325_GPIO_PIN_D1,GPIO_PIN_SET);
        else HAL_GPIO_WritePin(IL9325_GPIO_D1,IL9325_GPIO_PIN_D1,GPIO_PIN_RESET);
 if (byte&4) HAL_GPIO_WritePin(IL9325_GPIO_D2,IL9325_GPIO_PIN_D2,GPIO_PIN_SET);
        else HAL_GPIO_WritePin(IL9325_GPIO_D2,IL9325_GPIO_PIN_D2,GPIO_PIN_RESET);
 if (byte&8) HAL_GPIO_WritePin(IL9325_GPIO_D3,IL9325_GPIO_PIN_D3,GPIO_PIN_SET);
        else HAL_GPIO_WritePin(IL9325_GPIO_D3,IL9325_GPIO_PIN_D3,GPIO_PIN_RESET);
 if (byte&16) HAL_GPIO_WritePin(IL9325_GPIO_D4,IL9325_GPIO_PIN_D4,GPIO_PIN_SET);
        else HAL_GPIO_WritePin(IL9325_GPIO_D4,IL9325_GPIO_PIN_D4,GPIO_PIN_RESET);
 if (byte&32) HAL_GPIO_WritePin(IL9325_GPIO_D5,IL9325_GPIO_PIN_D5,GPIO_PIN_SET);
        else HAL_GPIO_WritePin(IL9325_GPIO_D5,IL9325_GPIO_PIN_D5,GPIO_PIN_RESET);
 if (byte&64) HAL_GPIO_WritePin(IL9325_GPIO_D6,IL9325_GPIO_PIN_D6,GPIO_PIN_SET);
        else HAL_GPIO_WritePin(IL9325_GPIO_D6,IL9325_GPIO_PIN_D6,GPIO_PIN_RESET);
 if (byte&128) HAL_GPIO_WritePin(IL9325_GPIO_D7,IL9325_GPIO_PIN_D7,GPIO_PIN_SET);
        else HAL_GPIO_WritePin(IL9325_GPIO_D7,IL9325_GPIO_PIN_D7,GPIO_PIN_RESET);
*/
}

//----------------------------------------------------------------------------------------------------
//выполнить сброс
//----------------------------------------------------------------------------------------------------
void IL9325_Reset(void)
{
 IL9325_CS_One();
 IL9325_RS_One();
 IL9325_RD_One();
 IL9325_WR_One();
 IL9325_RST_One();    
 HAL_Delay(10);
 IL9325_RST_Zero();
 HAL_Delay(10);
 IL9325_RST_One();
 HAL_Delay(250);
}
//----------------------------------------------------------------------------------------------------
//передать байт
//----------------------------------------------------------------------------------------------------
inline void IL9325_Write8(uint8_t byte)
{ 
 *((volatile uint8_t*)(LCD_DATA))=byte;
}
//----------------------------------------------------------------------------------------------------
//передать 16 бит 
//----------------------------------------------------------------------------------------------------
inline void IL9325_Write16(uint16_t value) 
{ 
 IL9325_Write8((value>>8)&0xFF);
 IL9325_Write8(value&0xFF);
}
//----------------------------------------------------------------------------------------------------
//выбрать регистр
//----------------------------------------------------------------------------------------------------
inline void IL9325_SelectRegister(uint16_t reg) 
{ 
 *((volatile uint8_t*)(LCD_REG))=(reg>>8)&0xFF;
 *((volatile uint8_t*)(LCD_REG))=reg&0xFF;
}
//----------------------------------------------------------------------------------------------------
//записать в регистр 16 бит
//----------------------------------------------------------------------------------------------------
inline void IL9325_WriteRegister16(uint16_t reg,uint16_t value) 
{ 
 IL9325_SelectRegister(reg);	
 IL9325_Write16(value);
}
//----------------------------------------------------------------------------------------------------
//записать в регистр 8 бит
//----------------------------------------------------------------------------------------------------
inline void IL9325_WriteRegister8(uint8_t reg,uint8_t value) 
{ 
 IL9325_SelectRegister(reg);	
 IL9325_Write8(value);
}
//----------------------------------------------------------------------------------------------------
//задать окно
//----------------------------------------------------------------------------------------------------
inline void IL9325_SetWindow(uint16_t x_left,uint16_t y_top,uint16_t x_right,uint16_t y_bottom)
{
 //указываем окно	
 IL9325_WriteRegister16(ILI932X_HOR_START_AD,x_left);
 IL9325_WriteRegister16(ILI932X_HOR_END_AD,x_right);
 IL9325_WriteRegister16(ILI932X_VER_START_AD,y_top);
 IL9325_WriteRegister16(ILI932X_VER_END_AD,y_bottom);
 //указываем текущие координаты	
 IL9325_WriteRegister16(ILI932X_GRAM_HOR_AD,x_left);
 IL9325_WriteRegister16(ILI932X_GRAM_VER_AD,y_top);
 //выбираем регистр вывода изображения
 IL9325_SelectRegister(ILI932X_RW_GRAM);
}
//------------------------------------------------------------------------------
//передать цвет точки
//------------------------------------------------------------------------------
void IL9325_OutColor(uint16_t color)
{
 IL9325_Write16(color);
}
//------------------------------------------------------------------------------
//вывести один пиксель
//------------------------------------------------------------------------------
void IL9325_PutPixel(int32_t x,int32_t y,uint16_t color)
{
 IL9325_SetWindow(x,y,x,y);
 IL9325_OutColor(color);
}

//----------------------------------------------------------------------------------------------------
//вывод символа в позицию
//----------------------------------------------------------------------------------------------------
void IL9325_PutSymbol(int32_t x,int32_t y,char symbol,uint16_t color)
{
 uint8_t s=(uint8_t)(symbol);
 if (s<=32) return;
 s-=32;
 if (s>223) return;
 //рисуем символ
 for(int32_t ys=0;ys<FONT_HEIGHT;ys++)
 {
  uint8_t byte=Font8x14[s][ys];
  uint8_t mask=128;
  for(int32_t xs=0;xs<FONT_WIDTH;xs++,mask>>=1)
  {   
   if (x+xs<0 || x+xs>=IL9325_HEIGHT) continue;
   if (y+ys<0 || y+ys>=IL9325_WIDTH) continue;
   if (byte&mask) IL9325_PutPixel(IL9325_WIDTH-(y+ys),x+xs,color);
  }
 }	
}
//----------------------------------------------------------------------------------------------------
//вывод строчки в позицию
//----------------------------------------------------------------------------------------------------
void IL9325_PutString(int32_t x,int32_t y,const char *string,uint16_t color)
{
 while((*string)!=0)
 {
  IL9325_PutSymbol(x,y,*string,color);
	x+=FONT_WIDTH;  
	string++;
 }	
}
//----------------------------------------------------------------------------------------------------
//вывести текст в текущую позицию
//----------------------------------------------------------------------------------------------------
void IL9325_Print(const char *string,uint16_t color)
{
 if (PrintYPosition+FONT_HEIGHT>=IL9325_HEIGHT) IL9325_Clear(IL9325_BLACK);
 IL9325_PutString(0,PrintYPosition,string,color);
 PrintYPosition+=FONT_HEIGHT;	
}
//----------------------------------------------------------------------------------------------------
//сбросить текущую позицию
//----------------------------------------------------------------------------------------------------
void IL9325_Clear(uint16_t color)
{
 PrintYPosition=0;	
 IL9325_SetWindow(0,0,IL9325_WIDTH-1,IL9325_HEIGHT-1);
 //выбираем регистр вывода изображения
 IL9325_SelectRegister(ILI932X_RW_GRAM);
 //передаём данные картинки
 IL9325_RS_One();
 for(int32_t y=0;y<IL9325_HEIGHT;y++)
 {
  for(int32_t x=0;x<IL9325_WIDTH;x++)
  {
	 IL9325_Write16(color);
  }
 }
}












